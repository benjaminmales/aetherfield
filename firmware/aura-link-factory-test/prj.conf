## CMakeLists.txt
```
cmake_minimum_required(VERSION 3.20.0)
find_package(Zephyr REQUIRED HINTS $ENV{ZEPHYR_BASE})

project(gateway_factory_test)

target_sources(app PRIVATE
  src/main.c
  src/w5500.c
  src/radio.c
)
```

## prj.conf
```kconfig
# Aetherfield gateway factory test — XIAO nRF54LM20A + W5500.
#
# Same build shape as the production gateway: raw 802.15.4, no Zephyr IP
# stack (the W5500 runs TCP/IP in silicon and is driven over SPI).

# --- 802.15.4 raw mode ------------------------------------------------------
CONFIG_NETWORKING=y
CONFIG_IEEE802154=y
CONFIG_IEEE802154_RAW_MODE=y
CONFIG_NET_PKT_TIMESTAMP=y
CONFIG_NRF_802154_RX_BUFFERS=16

CONFIG_MAIN_STACK_SIZE=4096
CONFIG_HEAP_MEM_POOL_SIZE=8192

# --- W5500 ------------------------------------------------------------------
CONFIG_SPI=y
CONFIG_GPIO=y
CONFIG_HWINFO=y

# --- console / shell (USB-C, via the onboard SAMD11) ------------------------
CONFIG_SHELL=y
CONFIG_SHELL_BACKEND_SERIAL=y
CONFIG_SHELL_VT100_COLORS=n
# The status line is printed from the main loop while the prompt is idle; with
# VT100 commands on, the shell redraws its prompt with cursor-move escapes that
# show up as ".[6D.[J" junk in plain serial terminals.
CONFIG_SHELL_VT100_COMMANDS=n
CONFIG_SHELL_PROMPT_UART="test> "

CONFIG_LOG=y
CONFIG_LOG_MODE_DEFERRED=y

# The board's nPM1300 PMIC provides the 3V3 rail; keep regulators enabled.
CONFIG_REGULATOR=y
```

## dts/bindings/spi/aetherfield,w5500-raw.yaml
```yaml
# WIZnet W5500 addressed directly through its own hardware TCP/IP sockets.
#
# Deliberately NOT "wiznet,w5500": that compatible binds Zephyr's Ethernet
# driver, which needs net_recv_data() — the symbol the raw 802.15.4 receive
# path already owns.

description: WIZnet W5500 driven via its on-chip TCP/IP stack

compatible: "aetherfield,w5500-raw"

include: spi-device.yaml

properties:
  int-gpios:
    type: phandle-array
    description: W5500 INTn, active low. Optional.

  reset-gpios:
    type: phandle-array
    description: W5500 RSTn, active low. Optional; software reset if absent.
```

## src/main.c
```c
/*
 * Aetherfield gateway — factory test firmware.
 * Target: Seeed XIAO nRF54LM20A on the XIAO W5500 Ethernet adapter.
 *
 * Needs no server and no Aetherfield infrastructure. On boot it runs every
 * check once, prints a PASS/FAIL report on the USB-C serial console
 * (115200 8N1), and shows the result on the XIAO's RGB LED:
 *
 *   blue   test running
 *   green  all checks passed (blinks once a second while idle)
 *   red    one or more checks failed (fast blink)
 *
 * After the report it keeps running: the W5500 answers ping on its static IP,
 * the radio broadcasts a test frame every second, and a status line is
 * printed every 5 seconds. Type 'help' at the console for commands.
 */

#include <zephyr/kernel.h>
#include <zephyr/device.h>
#include <zephyr/drivers/gpio.h>
#include <zephyr/drivers/hwinfo.h>
#include <zephyr/shell/shell.h>
#include <zephyr/sys/printk.h>
#include <stdarg.h>
#include <stdlib.h>
#include <string.h>

#include "w5500.h"
#include "radio.h"

#define FW_VERSION "1.0.2"

/* Default static address. Change at the console with: ip <a.b.c.d> */
static uint8_t g_ip[4]   = { 192, 168, 1, 200 };
static uint8_t g_mask[4] = { 255, 255, 255, 0 };
static uint8_t g_gw[4]   = { 192, 168, 1, 1 };

#define LINK_WAIT_MS     10000
#define RADIO_TX_FRAMES  5

/* ---- LEDs ---------------------------------------------------------------- */

static const struct gpio_dt_spec led_b = GPIO_DT_SPEC_GET(DT_ALIAS(led0), gpios);
static const struct gpio_dt_spec led_r = GPIO_DT_SPEC_GET(DT_ALIAS(led1), gpios);
static const struct gpio_dt_spec led_g = GPIO_DT_SPEC_GET(DT_ALIAS(led2), gpios);

static void led(bool r, bool g, bool b)
{
	gpio_pin_set_dt(&led_r, r);
	gpio_pin_set_dt(&led_g, g);
	gpio_pin_set_dt(&led_b, b);
}

/* ---- identity ------------------------------------------------------------ */

static uint8_t g_devid[8];
static uint8_t g_mac[6];

static void read_identity(void)
{
	uint8_t id[16] = { 0 };
	ssize_t n = hwinfo_get_device_id(id, sizeof(id));

	if (n < 8) {
		memset(id, 0xAE, sizeof(id));
		n = 8;
	}
	memcpy(g_devid, id, 8);

	/* Same derivation as the production gateway: locally administered,
	 * unicast, unique per unit with no provisioning. */
	g_mac[0] = 0x02;
	for (int i = 1; i < 6; i++) {
		g_mac[i] = id[(n - i) % n];
	}
}

/* ---- test run ------------------------------------------------------------ */

enum res { R_PASS, R_FAIL, R_SKIP, R_INFO };
static const char *const res_str[] = { "PASS", "FAIL", "SKIP", "INFO" };

static int g_failures;
static uint32_t g_fail_mask;   /* bit n = test n failed */
static bool g_last_pass;

static void report(int n, const char *name, enum res r, const char *fmt, ...)
{
	char detail[96];
	va_list ap;

	va_start(ap, fmt);
	vsnprintk(detail, sizeof(detail), fmt, ap);
	va_end(ap);

	printk("[%d] %-15s %-44s %s\n", n, name, detail, res_str[r]);
	if (r == R_FAIL) {
		g_failures++;
		g_fail_mask |= BIT(n);
	}
}

static void run_tests(void)
{
	g_failures = 0;
	g_fail_mask = 0;
	led(false, false, true);

	printk("\n==================================================================\n");
	printk(" GATEWAY FACTORY TEST  fw %s\n", FW_VERSION);
	printk(" Board     XIAO nRF54LM20A + W5500\n");
	printk(" Device ID %02X%02X%02X%02X%02X%02X%02X%02X\n",
	       g_devid[0], g_devid[1], g_devid[2], g_devid[3],
	       g_devid[4], g_devid[5], g_devid[6], g_devid[7]);
	printk(" MAC       %02X:%02X:%02X:%02X:%02X:%02X\n",
	       g_mac[0], g_mac[1], g_mac[2], g_mac[3], g_mac[4], g_mac[5]);
	printk(" IP        %u.%u.%u.%u / %u.%u.%u.%u\n",
	       g_ip[0], g_ip[1], g_ip[2], g_ip[3],
	       g_mask[0], g_mask[1], g_mask[2], g_mask[3]);
	printk("==================================================================\n");

	/* 1. W5500 present and answering on SPI. */
	int ver = w5500_reset_and_version();
	bool w5500_ok = (ver == 0x04);

	if (ver < 0) {
		report(1, "W5500 SPI", R_FAIL, "SPI error %d", ver);
	} else {
		report(1, "W5500 SPI", w5500_ok ? R_PASS : R_FAIL,
		       "VERSIONR=0x%02X (expect 0x04)%s", ver,
		       w5500_has_reset_pin() ? "" : ", no RST pin");
	}
	if (!w5500_ok) {
		printk("    -> check SCK/MISO/MOSI on D8/D9/D10, CS pin in the\n"
		       "       pin, and 3V3 at the W5500. 0x00/0xFF = no response.\n");
	}

	/* 2. Data integrity across the bus. */
	if (w5500_ok) {
		int bad = w5500_spi_integrity();

		report(2, "SPI integrity", bad == 0 ? R_PASS : R_FAIL,
		       bad < 0 ? "bus error" : "72 bytes written/read, %d mismatched",
		       bad);
		w5500_configure(g_mac, g_ip, g_mask, g_gw);
	} else {
		report(2, "SPI integrity", R_SKIP, "needs test 1");
	}

	/* 3. Ethernet PHY link. */
	bool link_ok = false;

	if (w5500_ok) {
		uint8_t phy = 0;
		int waited = 0;

		while (waited < LINK_WAIT_MS) {
			phy = w5500_phycfgr();
			if (phy & 0x01) {
				break;
			}
			k_msleep(100);
			waited += 100;
		}
		link_ok = (phy & 0x01) != 0;
		if (link_ok) {
			report(3, "Ethernet link", R_PASS, "%s %s-duplex",
			       (phy & 0x02) ? "100M" : "10M",
			       (phy & 0x04) ? "full" : "half");
		} else {
			report(3, "Ethernet link", R_FAIL,
			       "no link after %d s - cable/switch/magnetics",
			       LINK_WAIT_MS / 1000);
		}
	} else {
		report(3, "Ethernet link", R_SKIP, "needs test 1");
	}

	/*
	 * No W5500 INT test. On this adapter INT is not routed to the XIAO, and
	 * W5500 interrupts must stay disabled anyway: the ESP32 EN pad on the
	 * adapter lands on the nRF54's RST, and we do not want any path where
	 * enabling an interrupt could pull a reset line.
	 */

	/* 4. Radio transmit. */
	int ok = 0;

	for (int i = 0; i < RADIO_TX_FRAMES; i++) {
		if (radio_send_test_frame() == 0) {
			ok++;
		}
		k_msleep(20);
	}
	report(4, "802.15.4 TX", ok == RADIO_TX_FRAMES ? R_PASS : R_FAIL,
	       "%d/%d frames sent, ch %u, +8 dBm", ok, RADIO_TX_FRAMES,
	       radio_channel());

	/* 5. Radio receive — informational; needs a second unit running this
	 * test within range on the same channel. */
	struct radio_stats st;

	radio_get_stats(&st);
	if (st.rx_peer) {
		report(5, "802.15.4 RX", R_PASS, "peer %02X%02X%02X%02X heard, RSSI %d dBm",
		       st.last_peer_id[0], st.last_peer_id[1],
		       st.last_peer_id[2], st.last_peer_id[3], st.last_peer_rssi);
	} else {
		report(5, "802.15.4 RX", R_INFO,
		       "no peer yet (%u frames heard) - see status", st.rx_total);
	}

	printk("------------------------------------------------------------------\n");
	printk(" RESULT: %s  (%d failure%s)\n", g_failures ? "FAIL" : "PASS",
	       g_failures, g_failures == 1 ? "" : "s");
	printk("------------------------------------------------------------------\n");
	printk(" Next: ping %u.%u.%u.%u from a PC on the same subnet.\n",
	       g_ip[0], g_ip[1], g_ip[2], g_ip[3]);
	printk(" Radio RX: run a second unit; its ID appears in the status line.\n");
	printk(" Type 'help' for commands, 'test' to run again.\n\n");

	g_last_pass = (g_failures == 0);
}

/* ---- shell ---------------------------------------------------------------- */

static atomic_t g_req_test;
static atomic_t g_req_reconf;

static int parse_ip(const char *s, uint8_t out[4])
{
	for (int i = 0; i < 4; i++) {
		char *end;
		long v = strtol(s, &end, 10);

		if (end == s || v < 0 || v > 255 || (i < 3 && *end != '.') ||
		    (i == 3 && *end != '\0')) {
			return -EINVAL;
		}
		out[i] = (uint8_t)v;
		s = end + 1;
	}
	return 0;
}

static int c_test(const struct shell *sh, size_t argc, char **argv)
{
	atomic_set(&g_req_test, 1);
	return 0;
}

static int c_ip(const struct shell *sh, size_t argc, char **argv)
{
	uint8_t ip[4], mask[4], gw[4];

	memcpy(mask, g_mask, 4);
	if (parse_ip(argv[1], ip) ||
	    (argc > 2 && parse_ip(argv[2], mask)) ||
	    (argc > 3 && parse_ip(argv[3], gw))) {
		shell_error(sh, "usage: ip <a.b.c.d> [mask] [gateway]");
		return -EINVAL;
	}
	if (argc <= 3) {
		memcpy(gw, ip, 4);
		gw[3] = 1;
	}
	memcpy(g_ip, ip, 4);
	memcpy(g_mask, mask, 4);
	memcpy(g_gw, gw, 4);
	atomic_set(&g_req_reconf, 1);
	shell_print(sh, "IP %u.%u.%u.%u mask %u.%u.%u.%u gw %u.%u.%u.%u",
		    ip[0], ip[1], ip[2], ip[3], mask[0], mask[1], mask[2], mask[3],
		    gw[0], gw[1], gw[2], gw[3]);
	return 0;
}

static int c_chan(const struct shell *sh, size_t argc, char **argv)
{
	int ch = atoi(argv[1]);

	if (radio_set_channel((uint8_t)ch)) {
		shell_error(sh, "channel must be 11..26");
		return -EINVAL;
	}
	radio_reset_stats();
	shell_print(sh, "radio channel %d (both units must match)", ch);
	return 0;
}

SHELL_CMD_ARG_REGISTER(test, NULL, "Run the full factory test again", c_test, 1, 0);
SHELL_CMD_ARG_REGISTER(ip, NULL, "Set static IP: ip <a.b.c.d> [mask] [gateway]",
		       c_ip, 2, 2);
SHELL_CMD_ARG_REGISTER(chan, NULL, "Radio channel: chan <11-26>", c_chan, 2, 0);

/* ---- main ------------------------------------------------------------------ */

int main(void)
{
	gpio_pin_configure_dt(&led_r, GPIO_OUTPUT_INACTIVE);
	gpio_pin_configure_dt(&led_g, GPIO_OUTPUT_INACTIVE);
	gpio_pin_configure_dt(&led_b, GPIO_OUTPUT_INACTIVE);
	led(false, false, true);

	read_identity();

	/* Let the USB serial bridge enumerate so the report isn't lost. */
	k_msleep(1500);

	int err = radio_init(FT_RADIO_CHANNEL_DEFAULT, g_devid);

	if (err) {
		printk("radio init failed: %d\n", err);
	}

	run_tests();

	uint32_t tick = 0;

	for (;;) {
		if (atomic_cas(&g_req_test, 1, 0)) {
			radio_reset_stats();
			run_tests();
		}
		if (atomic_cas(&g_req_reconf, 1, 0)) {
			w5500_configure(g_mac, g_ip, g_mask, g_gw);
		}

		radio_send_test_frame();

		/* LED heartbeat: green blink on pass, fast red on fail. */
		if (g_last_pass) {
			led(false, true, false);
			k_msleep(100);
			led(false, false, false);
			k_msleep(900);
		} else {
			for (int i = 0; i < 5; i++) {
				led(true, false, false);
				k_msleep(100);
				led(false, false, false);
				k_msleep(100);
			}
		}

		if (++tick % 5 == 0) {
			struct radio_stats st;
			uint8_t phy = w5500_phycfgr();

			radio_get_stats(&st);
			printk("[status] eth %s | radio ch%u tx %u/%u rx %u",
			       (phy & 0x01) ? ((phy & 0x02) ? "up 100M" : "up 10M")
					    : "DOWN",
			       radio_channel(), st.tx_ok, st.tx_ok + st.tx_fail,
			       st.rx_total);
			if (st.rx_peer) {
				printk(" | peer %02X%02X%02X%02X x%u rssi %d",
				       st.last_peer_id[0], st.last_peer_id[1],
				       st.last_peer_id[2], st.last_peer_id[3],
				       st.rx_peer, st.last_peer_rssi);
			}
			if (g_last_pass) {
				printk(" | PASS\n");
			} else {
				printk(" | FAIL test");
				for (int t = 1; t <= 5; t++) {
					if (g_fail_mask & BIT(t)) {
						printk(" %d", t);
					}
				}
				printk(" - type 'test' for details\n");
			}
		}
	}
	return 0;
}
```

## src/radio.h
```c
#ifndef FT_RADIO_H
#define FT_RADIO_H

#include <stdint.h>
#include <stdbool.h>

#define FT_RADIO_CHANNEL_DEFAULT 15

int  radio_init(uint8_t channel, const uint8_t id[8]);
/* Transmit one test frame. 0 on success (radio reported TX done). */
int  radio_send_test_frame(void);
int  radio_set_channel(uint8_t ch);
uint8_t radio_channel(void);

struct radio_stats {
	uint32_t tx_ok, tx_fail;
	uint32_t rx_total;      /* any 802.15.4 frame heard */
	uint32_t rx_peer;       /* factory-test frames from another unit */
	int8_t   last_peer_rssi;
	uint8_t  last_peer_id[4];
};
void radio_get_stats(struct radio_stats *out);
void radio_reset_stats(void);

#endif
```

## src/w5500.c
```c
/*
 * Minimal W5500 register driver for the factory test.
 *
 * SPI framing (datasheet §2.2): [addr_hi] [addr_lo] [control] [data...]
 * control = (block << 3) | (write << 2) | OM, OM 0 = variable-length burst.
 * Block 0 = common registers; socket n = regs n*4+1, TX n*4+2, RX n*4+3.
 */

#include <zephyr/kernel.h>
#include <zephyr/device.h>
#include <zephyr/drivers/spi.h>
#include <zephyr/drivers/gpio.h>
#include <zephyr/sys/printk.h>
#include <string.h>
#include <errno.h>

#include "w5500.h"

#define W5500_NODE DT_NODELABEL(w5500)

static const struct spi_dt_spec spi = SPI_DT_SPEC_GET(W5500_NODE,
	SPI_WORD_SET(8) | SPI_OP_MODE_MASTER | SPI_TRANSFER_MSB, 0);

#define HAVE_RST DT_NODE_HAS_PROP(W5500_NODE, reset_gpios)
#define HAVE_INT DT_NODE_HAS_PROP(W5500_NODE, int_gpios)

#if HAVE_RST
static const struct gpio_dt_spec rst = GPIO_DT_SPEC_GET(W5500_NODE, reset_gpios);
#endif
#if HAVE_INT
static const struct gpio_dt_spec intn = GPIO_DT_SPEC_GET(W5500_NODE, int_gpios);
#endif

#define BLK_COMMON        0x00
#define BLK_SOCK_REG(n)   ((n) * 4 + 1)
#define BLK_SOCK_TX(n)    ((n) * 4 + 2)

#define CR_MR        0x0000
#define CR_GAR       0x0001
#define CR_SUBR      0x0005
#define CR_SHAR      0x0009
#define CR_SIPR      0x000F
#define CR_SIR       0x0017
#define CR_SIMR      0x0018
#define CR_PHYCFGR   0x002E
#define CR_VERSIONR  0x0039

#define SR_MR        0x0000
#define SR_CR        0x0001
#define SR_IR        0x0002
#define SR_SR        0x0003
#define SR_PORT      0x0004
#define SR_DIPR      0x000C
#define SR_DPORT     0x0010
#define SR_TX_FSR    0x0020
#define SR_TX_WR     0x0024
#define SR_IMR       0x002C

#define Sn_MR_UDP    0x02
#define Sn_CR_OPEN   0x01
#define Sn_CR_CLOSE  0x10
#define Sn_CR_SEND   0x20
#define Sn_SR_UDP    0x22
#define Sn_IR_SENDOK 0x10
#define Sn_IR_TIMEOUT 0x08

#define UDP_SOCK     1
#define SCRATCH_SOCK 7

static int xfer(uint16_t addr, uint8_t block, bool write,
		const uint8_t *out, uint8_t *in, size_t len)
{
	uint8_t hdr[3] = {
		(uint8_t)(addr >> 8), (uint8_t)(addr & 0xFF),
		(uint8_t)((block << 3) | (write ? 0x04 : 0x00)),
	};
	struct spi_buf tx_bufs[2] = {
		{ .buf = hdr, .len = sizeof(hdr) },
		{ .buf = (void *)out, .len = len },
	};
	const struct spi_buf_set tx = { .buffers = tx_bufs, .count = write ? 2 : 1 };

	if (write) {
		return spi_write_dt(&spi, &tx);
	}

	uint8_t dump[3];
	struct spi_buf rx_bufs[2] = {
		{ .buf = dump, .len = sizeof(dump) },
		{ .buf = in, .len = len },
	};
	const struct spi_buf_set rx = { .buffers = rx_bufs, .count = 2 };

	return spi_transceive_dt(&spi, &tx, &rx);
}

static uint8_t rd8(uint16_t a, uint8_t b) { uint8_t v = 0; xfer(a, b, false, NULL, &v, 1); return v; }
static void wr8(uint16_t a, uint8_t b, uint8_t v) { xfer(a, b, true, &v, NULL, 1); }
static void wr16(uint16_t a, uint8_t b, uint16_t v)
{
	uint8_t d[2] = { v >> 8, v & 0xFF };
	xfer(a, b, true, d, NULL, 2);
}
static uint16_t rd16(uint16_t a, uint8_t b)
{
	uint8_t d[2];
	uint16_t prev, cur;

	xfer(a, b, false, NULL, d, 2);
	prev = (d[0] << 8) | d[1];
	for (int i = 0; i < 8; i++) {
		xfer(a, b, false, NULL, d, 2);
		cur = (d[0] << 8) | d[1];
		if (cur == prev) {
			return cur;
		}
		prev = cur;
	}
	return prev;
}

static void sock_cmd(int s, uint8_t cmd)
{
	wr8(SR_CR, BLK_SOCK_REG(s), cmd);
	for (int i = 0; i < 1000 && rd8(SR_CR, BLK_SOCK_REG(s)); i++) {
		k_busy_wait(10);
	}
}

bool w5500_has_reset_pin(void) { return HAVE_RST; }
bool w5500_has_int_pin(void) { return HAVE_INT; }

int w5500_reset_and_version(void)
{
	if (!spi_is_ready_dt(&spi)) {
		return -ENODEV;
	}

#if HAVE_RST
	if (!gpio_is_ready_dt(&rst)) {
		return -ENODEV;
	}
	gpio_pin_configure_dt(&rst, GPIO_OUTPUT_ACTIVE);  /* RSTn low */
	k_msleep(2);                                      /* >500 us */
	gpio_pin_set_dt(&rst, 0);                         /* release */
	k_msleep(100);                                    /* PLL lock < 50 ms */
#endif
#if HAVE_INT
	if (gpio_is_ready_dt(&intn)) {
		gpio_pin_configure_dt(&intn, GPIO_INPUT);
	}
#endif

	wr8(CR_MR, BLK_COMMON, 0x80);                     /* software reset */
	k_msleep(10);

	uint8_t v;
	int err = xfer(CR_VERSIONR, BLK_COMMON, false, NULL, &v, 1);

	return err < 0 ? err : v;
}

int w5500_spi_integrity(void)
{
	/*
	 * Registers: GAR + SUBR (common block 0x0001..0x0008), 8 bytes that are
	 * plain read/write storage. They are reprogrammed by w5500_configure()
	 * straight after this test, so scribbling on them costs nothing.
	 * Patterns cover all-ones, all-zeros and alternating bits on MOSI/MISO.
	 *
	 * (v1.0.0 used socket 7's DIPR/DPORT here. Those read back as zero on
	 * real hardware while the socket is closed, which reported 5 bogus
	 * mismatches on a good board. Don't go back to them.)
	 */
	static const uint8_t reg_pat[8] = { 0xA5, 0x5A, 0xFF, 0x00,
					    0xC3, 0x3C, 0x0F, 0xF0 };
	uint8_t buf_pat[64], back[64];
	int bad = 0;

	xfer(CR_GAR, BLK_COMMON, true, reg_pat, NULL, sizeof(reg_pat));
	memset(back, 0, sizeof(back));
	if (xfer(CR_GAR, BLK_COMMON, false, NULL, back, sizeof(reg_pat)) < 0) {
		return -EIO;
	}
	for (int i = 0; i < (int)sizeof(reg_pat); i++) {
		if (back[i] != reg_pat[i]) {
			if (!bad) {
				printk("    reg 0x%04X: wrote %02X read %02X\n",
				       CR_GAR + i, reg_pat[i], back[i]);
			}
			bad++;
		}
	}

	/* 64-byte burst into socket 7's TX buffer memory and back: catches
	 * clock/timing problems that a single-byte read hides. */
	for (int i = 0; i < 64; i++) {
		buf_pat[i] = (uint8_t)(i * 37 + 11);
	}
	xfer(0x0000, BLK_SOCK_TX(SCRATCH_SOCK), true, buf_pat, NULL, 64);
	memset(back, 0, sizeof(back));
	if (xfer(0x0000, BLK_SOCK_TX(SCRATCH_SOCK), false, NULL, back, 64) < 0) {
		return -EIO;
	}
	for (int i = 0; i < 64; i++) {
		if (back[i] != buf_pat[i]) {
			if (!bad) {
				printk("    TX buf +%d: wrote %02X read %02X\n",
				       i, buf_pat[i], back[i]);
			}
			bad++;
		}
	}
	return bad;
}

int w5500_configure(const uint8_t mac[6], const uint8_t ip[4],
		    const uint8_t mask[4], const uint8_t gw[4])
{
	xfer(CR_SHAR, BLK_COMMON, true, mac, NULL, 6);
	xfer(CR_SIPR, BLK_COMMON, true, ip, NULL, 4);
	xfer(CR_SUBR, BLK_COMMON, true, mask, NULL, 4);
	return xfer(CR_GAR, BLK_COMMON, true, gw, NULL, 4);
}

uint8_t w5500_phycfgr(void)
{
	return rd8(CR_PHYCFGR, BLK_COMMON);
}

int w5500_udp_broadcast(const uint8_t *buf, size_t len, uint16_t port)
{
	static const uint8_t bcast[4] = { 255, 255, 255, 255 };
	const uint8_t s = UDP_SOCK;

	sock_cmd(s, Sn_CR_CLOSE);
	wr8(SR_MR, BLK_SOCK_REG(s), Sn_MR_UDP);
	wr16(SR_PORT, BLK_SOCK_REG(s), port);
	sock_cmd(s, Sn_CR_OPEN);
	if (rd8(SR_SR, BLK_SOCK_REG(s)) != Sn_SR_UDP) {
		return -EIO;
	}

	xfer(SR_DIPR, BLK_SOCK_REG(s), true, bcast, NULL, 4);
	wr16(SR_DPORT, BLK_SOCK_REG(s), port);

	if (rd16(SR_TX_FSR, BLK_SOCK_REG(s)) < len) {
		return -ENOMEM;
	}
	uint16_t wr = rd16(SR_TX_WR, BLK_SOCK_REG(s));

	xfer(wr, BLK_SOCK_TX(s), true, buf, NULL, len);
	wr16(SR_TX_WR, BLK_SOCK_REG(s), wr + len);
	sock_cmd(s, Sn_CR_SEND);
	return 0;
}

__attribute__((unused)) int w5500_int_test(void)
{
#if !HAVE_INT
	return -ENOTSUP;
#else
	const uint8_t s = UDP_SOCK;
	static const uint8_t msg[] = "FACTORY-TEST\n";
	int ret = -EIO;

	/* Only socket 1, only SEND_OK, routed to INTn. */
	wr8(SR_IMR, BLK_SOCK_REG(s), Sn_IR_SENDOK);
	wr8(SR_IR, BLK_SOCK_REG(s), 0xFF);
	wr8(CR_SIMR, BLK_COMMON, BIT(s));

	if (gpio_pin_get_dt(&intn) != 0) {
		/* Asserted before we did anything: stuck low or wrong pin. */
		ret = -EBUSY;
		goto out;
	}

	if (w5500_udp_broadcast(msg, sizeof(msg) - 1, 9) < 0) {
		goto out;
	}

	for (int i = 0; i < 200; i++) {
		if (gpio_pin_get_dt(&intn) == 1) {        /* active-low: asserted */
			ret = 0;
			break;
		}
		k_msleep(1);
	}
	if (ret != 0) {
		goto out;
	}

	/* Clear it and make sure the line is released. */
	wr8(SR_IR, BLK_SOCK_REG(s), 0xFF);
	k_msleep(2);
	if (gpio_pin_get_dt(&intn) != 0) {
		ret = -EBUSY;
	}

out:
	wr8(CR_SIMR, BLK_COMMON, 0);
	wr8(SR_IR, BLK_SOCK_REG(s), 0xFF);
	sock_cmd(s, Sn_CR_CLOSE);
	return ret;
#endif
}
```

## src/w5500.h
```c
/*
 * Minimal W5500 register driver for the factory test.
 * Same SPI framing and register map as GATEWAY/pixel-gateway/src/w5500.c.
 */
#ifndef W5500_H
#define W5500_H

#include <stdint.h>
#include <stdbool.h>
#include <stddef.h>

bool w5500_has_reset_pin(void);
bool w5500_has_int_pin(void);

/* Hardware (or software) reset, then return VERSIONR. <0 on bus error. */
int w5500_reset_and_version(void);

/* Write patterns to scratch registers and a socket buffer, read them back.
 * Returns number of mismatched bytes (0 = pass), <0 on bus error. */
int w5500_spi_integrity(void);

/* Program MAC (derived from SoC device ID), IP, mask, gateway. */
int w5500_configure(const uint8_t mac[6], const uint8_t ip[4],
		    const uint8_t mask[4], const uint8_t gw[4]);

uint8_t w5500_phycfgr(void);

/* INT pin test: arm an interrupt, provoke it with a UDP broadcast, check INTn
 * goes low, clear it, check INTn goes high again.
 * Returns 0 pass, -EIO INT never asserted, -EBUSY INT never released,
 * -ENOTSUP no int-gpios in devicetree. */
int w5500_int_test(void);

/* Send one UDP broadcast datagram from socket 1 (used by the INT test and
 * visible in Wireshark as a "hello" from the unit). */
int w5500_udp_broadcast(const uint8_t *buf, size_t len, uint16_t port);

#endif
```

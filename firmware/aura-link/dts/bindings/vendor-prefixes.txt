## firmware/boards/holyiot/holyiot_25008_nrf54l15/Kconfig.holyiot_25008_nrf54l15
```kconfig
# SPDX-License-Identifier: Apache-2.0

config BOARD_HOLYIOT_25008_NRF54L15
	select SOC_NRF54L15_CPUAPP if BOARD_HOLYIOT_25008_NRF54L15_NRF54L15_CPUAPP
```

## lab/boards/kkm/k4beacon_nrf54l15/Kconfig.k4beacon_nrf54l15
```kconfig
# SPDX-License-Identifier: Apache-2.0

config BOARD_K4BEACON_NRF54L15
	select SOC_NRF54L15_CPUAPP if BOARD_K4BEACON_NRF54L15_NRF54L15_CPUAPP
```

## lab/boards/kkm/k4beacon_nrf54l15/board.yml
```yaml
board:
  name: k4beacon_nrf54l15
  full_name: KKM K4 Beacon nRF54L15
  vendor: kkm
  socs:
    - name: nrf54l15
```

## lab/boards/kkm/k7beacon_nrf54l15/board.yml
```yaml
board:
  name: k7beacon_nrf54l15
  full_name: KKM K7 Beacon nRF54L15
  vendor: kkm
  socs:
    - name: nrf54l15
```

## lab/devices/reference/holyiot/holyiot_25008_nrf54l15/board.yml
```yaml
board:
  name: holyiot_25008_nrf54l15
  full_name: Holyiot 25008 nRF54L15 Module
  vendor: holyiot
  socs:
    - name: nrf54l15
```

## lab/devices/reference/holyiot/holyiot_25008_nrf54l15/holyiot_25008_nrf54l15_nrf54l15_cpuapp_defconfig
```kconfig
# SPDX-License-Identifier: Apache-2.0

# Serial / console
CONFIG_SERIAL=y
CONFIG_CONSOLE=y
CONFIG_UART_CONSOLE=y

# GPIO / PWM / SPI
CONFIG_GPIO=y
CONFIG_PWM=y
CONFIG_SPI=y

# Power management
CONFIG_PM_DEVICE=y
CONFIG_NRFX_POWER=y

# CPU protection
CONFIG_ARM_MPU=y
CONFIG_HW_STACK_PROTECTION=y
CONFIG_NULL_POINTER_EXCEPTION_DETECTION_NONE=y

# Caches
CONFIG_CACHE_MANAGEMENT=y
CONFIG_EXTERNAL_CACHE=y

# GRTC syscounter for boot timestamping
CONFIG_NRF_GRTC_START_SYSCOUNTER=y

# Regulator (vregmain mode select)
CONFIG_REGULATOR=y
CONFIG_REGULATOR_FIXED_INIT_PRIORITY=45
```

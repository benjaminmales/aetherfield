/*
 * K4 Beacon -- GPIO pin sweep, timed.
 *
 * Finds an LED whose pin is not documented, with no console and no blink
 * decoding: every GPIO gets an identical, exactly-timed slot, so the ONE
 * number you need is how many seconds after reset the LED lit.
 *
 * Timeline from reset (all constants below, table in README.md):
 *
 *     0.0 s   reset -- start the stopwatch here
 *     5.0 s   PASS A begins   open-drain, sinking     (active-LOW LED)
 *   101.0 s   PASS A ends, 8 s dark
 *   109.0 s   PASS B begins   push-pull, sourcing     (active-HIGH LED)
 *   205.0 s   PASS B ends, 10 s dark
 *   215.0 s   repeats, identically, forever
 *
 * Each slot is 3.000 s: 2.5 s lit, 0.5 s dark guard so the boundary is
 * visible. Pin order is fixed: P0.00-04, P1.00-15, P2.00-10 (32 slots).
 *
 *     slot  = floor((t - pass_start) / 3)
 *
 * Both passes use the SAME slot numbering -- a skipped or unconfigurable pin
 * stays dark for its full slot rather than shifting everything after it, so a
 * time only ever maps to one pin.
 *
 * Which pass lit it is the polarity answer: pass A means the LED is
 * common-anode / active-low, pass B means common-cathode / active-high.
 *
 * Slot boundaries are scheduled against absolute uptime, not by adding sleeps,
 * so per-call overhead cannot accumulate across a 200 s cycle. Measure twice --
 * it repeats identically.
 *
 * Pass A is open-drain: it can only sink, so it physically cannot fight another
 * chip driving the same net, and is safe on every pin. Pass B is push-pull and
 * CAN contend, so pins that are outputs on the K7 are skipped (PUSH_PULL_SKIP).
 *
 * SPDX-License-Identifier: Apache-2.0
 */

#include <zephyr/kernel.h>
#include <zephyr/device.h>
#include <zephyr/drivers/gpio.h>
#include <zephyr/logging/log.h>

LOG_MODULE_DECLARE(k4_hello, LOG_LEVEL_INF);

/* ---- timing. Change these and regenerate the README table. -------------- */
#define LEAD_IN_MS      5000
#define SLOT_MS         3000
#define SLOT_ON_MS      2500
#define PASS_GAP_MS     8000
#define CYCLE_TAIL_MS  10000

/* ---- the pin list, in slot order ---------------------------------------- */
struct sweep_pin {
	const struct device *dev;
	uint8_t port;
	uint8_t pin;
};

/*
 * Written out entry by entry rather than generated by a list macro: this file
 * cannot be compile-tested from here, and a macro that expands wrongly costs a
 * whole build cycle. Port sizes from the SoC devicetree: P0 = 5, P1 = 16,
 * P2 = 11. SLOT ORDER IS THE CONTRACT -- it must match the table in README.md.
 */
static const struct sweep_pin pins[] = {
	{ DEVICE_DT_GET(DT_NODELABEL(gpio0)), 0,  0 },
	{ DEVICE_DT_GET(DT_NODELABEL(gpio0)), 0,  1 },
	{ DEVICE_DT_GET(DT_NODELABEL(gpio0)), 0,  2 },
	{ DEVICE_DT_GET(DT_NODELABEL(gpio0)), 0,  3 },
	{ DEVICE_DT_GET(DT_NODELABEL(gpio0)), 0,  4 },
	{ DEVICE_DT_GET(DT_NODELABEL(gpio1)), 1,  0 },
	{ DEVICE_DT_GET(DT_NODELABEL(gpio1)), 1,  1 },
	{ DEVICE_DT_GET(DT_NODELABEL(gpio1)), 1,  2 },
	{ DEVICE_DT_GET(DT_NODELABEL(gpio1)), 1,  3 },
	{ DEVICE_DT_GET(DT_NODELABEL(gpio1)), 1,  4 },
	{ DEVICE_DT_GET(DT_NODELABEL(gpio1)), 1,  5 },
	{ DEVICE_DT_GET(DT_NODELABEL(gpio1)), 1,  6 },
	{ DEVICE_DT_GET(DT_NODELABEL(gpio1)), 1,  7 },
	{ DEVICE_DT_GET(DT_NODELABEL(gpio1)), 1,  8 },
	{ DEVICE_DT_GET(DT_NODELABEL(gpio1)), 1,  9 },
	{ DEVICE_DT_GET(DT_NODELABEL(gpio1)), 1, 10 },
	{ DEVICE_DT_GET(DT_NODELABEL(gpio1)), 1, 11 },
	{ DEVICE_DT_GET(DT_NODELABEL(gpio1)), 1, 12 },
	{ DEVICE_DT_GET(DT_NODELABEL(gpio1)), 1, 13 },
	{ DEVICE_DT_GET(DT_NODELABEL(gpio1)), 1, 14 },
	{ DEVICE_DT_GET(DT_NODELABEL(gpio1)), 1, 15 },
	{ DEVICE_DT_GET(DT_NODELABEL(gpio2)), 2,  0 },
	{ DEVICE_DT_GET(DT_NODELABEL(gpio2)), 2,  1 },
	{ DEVICE_DT_GET(DT_NODELABEL(gpio2)), 2,  2 },
	{ DEVICE_DT_GET(DT_NODELABEL(gpio2)), 2,  3 },
	{ DEVICE_DT_GET(DT_NODELABEL(gpio2)), 2,  4 },
	{ DEVICE_DT_GET(DT_NODELABEL(gpio2)), 2,  5 },
	{ DEVICE_DT_GET(DT_NODELABEL(gpio2)), 2,  6 },
	{ DEVICE_DT_GET(DT_NODELABEL(gpio2)), 2,  7 },
	{ DEVICE_DT_GET(DT_NODELABEL(gpio2)), 2,  8 },
	{ DEVICE_DT_GET(DT_NODELABEL(gpio2)), 2,  9 },
	{ DEVICE_DT_GET(DT_NODELABEL(gpio2)), 2, 10 },
};

#define N_SLOTS ARRAY_SIZE(pins)

/*
 * Skipped in the push-pull pass only. On the K7 these are the LIS2DW12
 * INT1 / INT2 lines -- push-pull outputs from the sensor. Driving a pin that
 * another chip is also driving is the one way this sweep could damage
 * something. Their slots still elapse, dark, so the timing table stays valid.
 * Delete entries once the K4 schematic shows these nets are free.
 */
static const struct { uint8_t port, pin; } PUSH_PULL_SKIP[] = {
	{ 1, 6 },
	{ 1, 7 },
};

static bool push_pull_skipped(uint8_t port, uint8_t pin)
{
	for (size_t i = 0; i < ARRAY_SIZE(PUSH_PULL_SKIP); i++) {
		if (PUSH_PULL_SKIP[i].port == port &&
		    PUSH_PULL_SKIP[i].pin == pin) {
			return true;
		}
	}
	return false;
}

/* Drive one pin for SLOT_ON_MS. Never sleeps -- the caller owns the clock. */
static void slot_light(const struct sweep_pin *sp, bool open_drain)
{
	gpio_flags_t flags = open_drain ? (GPIO_OUTPUT_HIGH | GPIO_OPEN_DRAIN)
					: GPIO_OUTPUT_LOW;
	int active = open_drain ? 0 : 1;
	int err;

	if (!device_is_ready(sp->dev)) {
		return;
	}

	err = gpio_pin_configure(sp->dev, sp->pin, flags);
	if (err) {
		/* NFC (P1.02/P1.03) and crystal pins can be claimed by UICR.
		 * A refusal is information; the slot still elapses dark. */
		LOG_WRN("P%u.%02u: configure failed (%d)", sp->port, sp->pin, err);
		return;
	}

	gpio_pin_set_raw(sp->dev, sp->pin, active);
	k_msleep(SLOT_ON_MS);
	gpio_pin_set_raw(sp->dev, sp->pin, !active);

	/* Leave it floating, never latched. */
	gpio_pin_configure(sp->dev, sp->pin, GPIO_DISCONNECTED);
}

/*
 * Sleep until an absolute uptime. Self-correcting: every slot is measured from
 * the pass base, so per-call overhead cannot accumulate over a 200 s cycle.
 * Plain k_msleep on a computed remainder, so it depends on no optional kernel
 * timeout features.
 */
static void sleep_until(int64_t deadline_ms)
{
	int64_t now = k_uptime_get();

	if (deadline_ms > now) {
		k_msleep((int32_t)(deadline_ms - now));
	}
}

/* Runs one pass, every slot anchored to `base` so nothing drifts. */
static void timed_pass(int64_t base, bool open_drain)
{
	LOG_INF("=== PASS %c: %s ===", open_drain ? 'A' : 'B',
		open_drain ? "open-drain, sinking (active-LOW LED)"
			   : "push-pull, sourcing (active-HIGH LED)");

	for (size_t i = 0; i < N_SLOTS; i++) {
		const struct sweep_pin *sp = &pins[i];

		sleep_until(base + (int64_t)i * SLOT_MS);

		if (!open_drain && push_pull_skipped(sp->port, sp->pin)) {
			LOG_INF("slot %2u  P%u.%02u  SKIPPED (external output?)",
				(unsigned)i, sp->port, sp->pin);
			continue;
		}

		LOG_INF("slot %2u  P%u.%02u", (unsigned)i, sp->port, sp->pin);
		slot_light(sp, open_drain);
	}
}

void k4_pin_sweep(void)
{
	uint32_t cycle = 0;

	BUILD_ASSERT(N_SLOTS == 32, "expected 32 GPIOs across P0/P1/P2");

	LOG_INF("K4 timed pin sweep -- %u slots x %u ms, two polarity passes",
		(unsigned)N_SLOTS, SLOT_MS);
	LOG_INF("Start a stopwatch AT RESET. slot = (t - pass_start) / 3 s.");
	LOG_INF("Pass A starts t=%u.0 s (active-low), pass B t=%u.0 s (active-high)",
		LEAD_IN_MS / 1000,
		(LEAD_IN_MS + N_SLOTS * SLOT_MS + PASS_GAP_MS) / 1000);

	while (1) {
		int64_t cycle_start = k_uptime_get();
		int64_t pass_a = cycle_start + LEAD_IN_MS;
		int64_t pass_b = pass_a + (int64_t)N_SLOTS * SLOT_MS + PASS_GAP_MS;

		LOG_INF("---------- cycle %u ----------", ++cycle);
		timed_pass(pass_a, true);
		timed_pass(pass_b, false);

		sleep_until(pass_b + (int64_t)N_SLOTS * SLOT_MS +
			    CYCLE_TAIL_MS);
	}
}

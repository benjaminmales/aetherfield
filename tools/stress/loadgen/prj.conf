## CMakeLists.txt
```
cmake_minimum_required(VERSION 3.20.0)
find_package(Zephyr REQUIRED HINTS $ENV{ZEPHYR_BASE})

project(aetherfield-loadgen)

# aura_radio.h — the SAME wire-format header the real Pixels and the gateway
# use. The whole point of this app is that the frames it emits are
# indistinguishable from a real device's, so it must never carry its own copy.
target_include_directories(app PRIVATE ${CMAKE_CURRENT_SOURCE_DIR}/../../../include)

# The shared band layer — the SAME file the shipping Pixels run. This app is
# production firmware plus a virtual fleet, not a model of it.
target_include_directories(app PRIVATE ${CMAKE_CURRENT_SOURCE_DIR}/../../../firmware/common)

target_sources(app PRIVATE
  src/main.c
  ../../../firmware/common/aura_band.c
)
```

## Kconfig
```
# Load generator options.
#
# SIM_BLOCK is the one setting that MUST be unique per board. Two boards
# sharing a block emit the same addresses, the server dedupes them as one
# device, and the fleet silently appears half the size it should be — which
# looks exactly like 50% packet loss. Set it from a fragment (tag01.conf ..),
# never by editing a file between flashes.

menu "Aetherfield load generator"

config SIM_DEVICES
	int "Virtual devices emitted by this board"
	default 150
	range 1 500
	help
	  Each gets its own address, its own slot in the beacon cycle and its
	  own last-cmd-seq echo. 20 boards x 150 = 3000.

config SIM_BLOCK
	int "Address block index for this board (-1 = derive at runtime)"
	default -1
	range -1 408
	help
	  Addresses are AURA_ADDR_BAND_BASE + block*SIM_DEVICES + i.

	  Leave this at -1 and the board derives its block from the factory
	  device id at boot, which means ONE binary flashes to all twenty
	  boards. That is worth a great deal: the old scheme needed twenty
	  Kconfig fragments and twenty full Zephyr builds to vary one integer.

	  The cost is that derivation is a birthday problem. Twenty boards into
	  409 blocks clash with probability 37.6%, and a clash is invisible in
	  the worst way — two boards emit the same addresses, the server dedupes
	  them into one device, and the fleet looks 150 devices short, which
	  reads as packet loss rather than as a numbering fault.

	  So the board prints its block at boot, the server reports how many
	  distinct blocks it can see, and 'sim block <n>' moves a board over RTT
	  without rebuilding. Set this to a fixed value only if you want one
	  particular board pinned.

config SIM_BEACON_MS
	int "Unused — kept so existing fragments still parse"
	default 10000
	range 100 60000
	help
	  The beacon interval now comes from the commanded op_param over the
	  air (op_param x 100 ms, 0 meaning AURA_BEACON_DEFAULT_MS), exactly as
	  it does on a real Pixel. Set it for the whole fleet at once from the
	  dashboard with 'aura op 0 <param>'; override one board locally with
	  'sim rate <ms>'.

	  Twenty boards on hardware with no UART is twenty RTT sessions, and a
	  sweep where each board changes rate at a different moment is a smear
	  rather than a measurement.

config SIM_CSMA
	bool "Use CSMA/CA instead of direct transmit"
	default n
	help
	  The shipping firmware transmits with IEEE802154_TX_MODE_DIRECT — it
	  does not listen before it talks, which makes the uplink unslotted
	  ALOHA. ALOHA peaks around 18% channel utilisation and gets WORSE as
	  offered load rises beyond that.

	  Switch live with 'sim csma 1' and compare delivery rates at the same
	  offered load. That comparison is the most useful number this whole
	  test produces.

endmenu

source "Kconfig.zephyr"
```

## prj.conf
```kconfig
# Aetherfield load generator — nRF54L15 TAG.
#
# Deliberately the same radio configuration as firmware/pixels/*: raw
# 802.15.4, same PAN, same channel, same frame builder from aura_radio.h. A
# gateway cannot tell one of these frames from a real Pixel's, which is the
# only way the measurement means anything.

CONFIG_NETWORKING=y
CONFIG_IEEE802154=y
CONFIG_IEEE802154_RAW_MODE=y
CONFIG_NET_PKT_TIMESTAMP=y

# We transmit far more than we receive, but the CMD downlink still has to land
# — that is how each virtual device gets the cmd_seq it echoes, and therefore
# how the server measures downlink delivery.
CONFIG_NRF_802154_RX_BUFFERS=32

# aura_band derives this board's own address from the factory device id.
CONFIG_HWINFO=y
CONFIG_GPIO=y

# The TAG's RGB LED is plain GPIO, so no PWM is needed. aura_band's animation
# engine still runs in full; render() just thresholds each channel.

# --- console: RTT, because this board has none -------------------------------
#
# The nRF54L15 TAG defines no UART and no zephyr,console in its devicetree —
# its whole defconfig is CONFIG_GPIO and CONFIG_ARM_MPU. It is a tag, not a
# development kit, and there is nowhere to plug a serial cable.
#
# Asking for SHELL_BACKEND_SERIAL here fails in a thoroughly confusing way:
# Kconfig quietly drops UART_CONSOLE ("unsatisfied dependencies:
# SERIAL_HAS_DRIVER (=n)") and then shell_uart.c fails to compile on an
# undeclared __device_dts_ord_DT_CHOSEN_zephyr_shell_uart_ORD. Hundreds of
# lines of C error whose actual cause is one warning near the top of the log.
#
# RTT runs over the SWD connection you already flash through, so it costs no
# wiring at all. Read it with the nRF Connect RTT terminal or JLinkRTTViewer.
CONFIG_SERIAL=n
CONFIG_CONSOLE=y
CONFIG_USE_SEGGER_RTT=y
CONFIG_RTT_CONSOLE=y
CONFIG_SHELL=y
CONFIG_SHELL_BACKEND_SERIAL=n
CONFIG_SHELL_BACKEND_RTT=y
CONFIG_SHELL_VT100_COLORS=n

CONFIG_LOG=y
CONFIG_LOG_MODE_DEFERRED=y

# NOT the RTT log backend.
#
# The shell already owns RTT channel 0, and the RTT log backend defaults to
# channel 0 as well — Zephyr catches that with a BUILD_ASSERT reading
# "Conflicting log RTT backend enabled on the same channel", which is accurate
# but well hidden inside shell_rtt.c.
#
# Two ways out: move the log to channel 1, or let the shell carry it. The
# shell's own log backend is on by default and puts log lines in the same
# window as the command output, which is what you want when you are typing
# 'sim stats' and watching for a warning. One channel, one window.
CONFIG_LOG_BACKEND_RTT=n

# Shell and log share one RTT up-buffer, so give it room. The default 1024 is
# enough to lose a burst of log lines at boot.
CONFIG_SEGGER_RTT_BUFFER_SIZE_UP=4096
CONFIG_BOOT_BANNER=n

# 500 virtual devices x 2 bytes of state is nothing; the stack headroom is for
# the transmit path running from a timer-driven work item.
CONFIG_MAIN_STACK_SIZE=2048
CONFIG_HEAP_MEM_POOL_SIZE=8192
# The load generator has its own thread now (see src/main.c), so the system
# workqueue is back to carrying only what Zephyr puts on it.
```

## tag01.conf
```kconfig
# Board 1 of 20. Addresses 0x1000 .. 0x1095.
CONFIG_SIM_BLOCK=0
```

## tag02.conf
```kconfig
# Board 2 of 20. Addresses 0x1096 .. 0x112B.
CONFIG_SIM_BLOCK=1
```

## tag03.conf
```kconfig
# Board 3 of 20. Addresses 0x112C .. 0x11C1.
CONFIG_SIM_BLOCK=2
```

## tag04.conf
```kconfig
# Board 4 of 20. Addresses 0x11C2 .. 0x1257.
CONFIG_SIM_BLOCK=3
```

## tag05.conf
```kconfig
# Board 5 of 20. Addresses 0x1258 .. 0x12ED.
CONFIG_SIM_BLOCK=4
```

## tag06.conf
```kconfig
# Board 6 of 20. Addresses 0x12EE .. 0x1383.
CONFIG_SIM_BLOCK=5
```

## src/main.c
```c
/*
 * Aetherfield load generator — nRF54L15 TAG.
 *
 * This is NOT a simulator. It is the shipping Pixel firmware — the same
 * ../../firmware/common/aura_band.c that runs on the K4, the Holyiot and the
 * XIAO — with one addition: after beaconing as itself, the board also beacons
 * as CONFIG_SIM_DEVICES other addresses.
 *
 * Everything else is real. CMD receive, sequence dedupe, group matching, the
 * op_mode state machine, the shared-clock animation engine at 50 Hz, SYNC,
 * the channel-loss fallback: all of it is the production code path, because
 * it IS the production code path. A test that exercised a second
 * implementation would be measuring the second implementation.
 *
 * The visible consequence, and the point: the RGB LED obeys real commands.
 * Send a colour from the console and twenty boards change together. That is
 * not a proxy for downlink delivery — it IS downlink delivery, at a glance,
 * across the room.
 *
 * ---------------------------------------------------------------------------
 * What is real and what is not
 * ---------------------------------------------------------------------------
 *
 * REAL: every frame. Built by aura_band's own writers through its own radio,
 * so a gateway cannot tell a virtual device from a real one, and neither can
 * anything downstream of it.
 *
 * NOT REAL: contention between the devices on one board. A real fleet has
 * 3,000 independent radios colliding; a board has one radio that serialises
 * its 150 frames. They are spread evenly across the beacon interval rather
 * than bursting, which narrows the gap without closing it.
 *
 * ALSO NOT REAL: spatial reuse. Twenty boards in one room is a single
 * collision domain carrying every frame; a venue spreads the same fleet over
 * ground where each patch of air carries only its local devices. This test is
 * therefore OPTIMISTIC about collisions and PESSIMISTIC about geography. The
 * useful way to put that to a client: if it holds up with everything in one
 * room, the venue is the easier case.
 */

#include <zephyr/kernel.h>
#include <zephyr/device.h>
#include <zephyr/drivers/gpio.h>
#include <zephyr/shell/shell.h>
#include <zephyr/logging/log.h>
#include <zephyr/sys/util.h>   /* MAX() in the mono-LED fallback */
#include <zephyr/drivers/hwinfo.h>
#include <stdlib.h>

#include "aura_band.h"

LOG_MODULE_REGISTER(loadgen, CONFIG_LOG_DEFAULT_LEVEL);

#define SIM_DEVICES CONFIG_SIM_DEVICES

/* A frame is ~736 us on air. Slots shorter than this mean the board cannot
 * keep up and you are measuring the load generator, not the network. */
#define SLOT_MIN_US 1200

/*
 * ONE BINARY FOR EVERY BOARD.
 *
 * The block used to be CONFIG_SIM_BLOCK, which meant twenty Kconfig fragments
 * and twenty full Zephyr builds to change one integer. Now it is decided at
 * runtime from the factory device id, so the same hex flashes to all twenty
 * and the only per-board step is plugging in the next board.
 *
 * WHY THIS IS NOT JUST A HASH, AND WHY IT PRINTS SO LOUDLY.
 *
 * Hashing a device id into blocks is a birthday problem, and it is a much
 * worse one than it looks. The band range holds 409 blocks of 150. Twenty
 * boards into 409 blocks collide with probability 37.6% — better than even
 * odds of a clean run, but nowhere near safe enough to trust silently.
 *
 * And a clash is invisible in exactly the wrong way: two boards emit the same
 * 150 addresses, the server dedupes them into one device, and the fleet
 * appears 150 devices short. That does not look like a numbering bug. It looks
 * like 50% packet loss on part of the range, which is precisely the thing this
 * rig exists to measure — so it would be read as a result rather than a fault.
 *
 * So the board announces its block at boot, the server counts how many
 * distinct blocks it can see, and 'sim block <n>' reassigns one board over RTT
 * without a rebuild. Expect to use it on roughly one run in three, on one
 * board.
 */
#define SIM_BLOCKS  ((AURA_ADDR_BAND_MAX - AURA_ADDR_BAND_BASE + 1) / SIM_DEVICES)

static uint16_t g_block;

#define ADDR_OF(i) ((uint16_t)(AURA_ADDR_BAND_BASE + g_block * SIM_DEVICES + (i)))

/*
 * Derive a block from the factory device id.
 *
 * Same source aura_band uses for the board's own address, so a board's block
 * and its real device address move together — flash the same hex twice and you
 * get the same answer twice, which is what makes a run reproducible.
 */
static uint16_t derive_block(void)
{
	uint8_t uid[16] = {0};
	ssize_t n = hwinfo_get_device_id(uid, sizeof(uid));

	if (n <= 0) {
		LOG_WRN("no factory device id; falling back to block 0. If two "
			"boards do this they WILL clash — set 'sim block <n>'.");
		return 0;
	}

	/* FNV-1a over the whole id. The low bytes of an nRF device id are not
	 * uniformly distributed, so taking a modulus of them directly would
	 * cluster; mixing every byte first costs nothing here. */
	uint32_t h = 2166136261u;

	for (ssize_t i = 0; i < n; i++) {
		h ^= uid[i];
		h *= 16777619u;
	}
	return (uint16_t)(h % SIM_BLOCKS);
}

/* ------------------------------------------------------------------ LED -- */
/*
 * The TAG's RGB LED is three plain GPIOs — no PWM — so each channel is on or
 * off and the board shows eight colours rather than a gamut. That is enough
 * for the job: the question this answers is "did the command arrive", and a
 * room of boards going from red to blue together answers it from the far side
 * of the room.
 *
 * The threshold sits low (64, not 128) so a dimmed command still lights
 * something. Animations stay visible either way: flash and pulse cross the
 * threshold, so they blink exactly as they should.
 */
#define CH_ON 64

#if DT_NODE_EXISTS(DT_NODELABEL(led1_red)) && \
    DT_NODE_EXISTS(DT_NODELABEL(led1_green)) && \
    DT_NODE_EXISTS(DT_NODELABEL(led1_blue))
#define HAVE_RGB 1
static const struct gpio_dt_spec led_r = GPIO_DT_SPEC_GET(DT_NODELABEL(led1_red), gpios);
static const struct gpio_dt_spec led_g = GPIO_DT_SPEC_GET(DT_NODELABEL(led1_green), gpios);
static const struct gpio_dt_spec led_b = GPIO_DT_SPEC_GET(DT_NODELABEL(led1_blue), gpios);
#elif DT_NODE_EXISTS(DT_ALIAS(led0))
#define HAVE_MONO 1
static const struct gpio_dt_spec led_mono = GPIO_DT_SPEC_GET(DT_ALIAS(led0), gpios);
#endif

static bool g_led_ready;

/* Called from aura_band's animation thread at ~50 Hz with the colour already
 * resolved: animation and master brightness applied. Paint only. */
static void render(uint8_t r, uint8_t g, uint8_t b)
{
	if (!g_led_ready) {
		return;
	}
#ifdef HAVE_RGB
	gpio_pin_set_dt(&led_r, r >= CH_ON);
	gpio_pin_set_dt(&led_g, g >= CH_ON);
	gpio_pin_set_dt(&led_b, b >= CH_ON);
#elif defined(HAVE_MONO)
	gpio_pin_set_dt(&led_mono, MAX(r, MAX(g, b)) >= CH_ON);
#else
	ARG_UNUSED(r); ARG_UNUSED(g); ARG_UNUSED(b);
#endif
}

static bool led_init(void)
{
#ifdef HAVE_RGB
	if (!gpio_is_ready_dt(&led_r) || !gpio_is_ready_dt(&led_g) ||
	    !gpio_is_ready_dt(&led_b)) {
		return false;
	}
	gpio_pin_configure_dt(&led_r, GPIO_OUTPUT_INACTIVE);
	gpio_pin_configure_dt(&led_g, GPIO_OUTPUT_INACTIVE);
	gpio_pin_configure_dt(&led_b, GPIO_OUTPUT_INACTIVE);
	return true;
#elif defined(HAVE_MONO)
	if (!gpio_is_ready_dt(&led_mono)) {
		return false;
	}
	gpio_pin_configure_dt(&led_mono, GPIO_OUTPUT_INACTIVE);
	return true;
#else
	return false;
#endif
}

/* ---------------------------------------------------- virtual fleet ---- */

/*
 * Beacon interval.
 *
 * By default the virtual fleet follows the SAME over-the-air setting the real
 * device does: aura_band reads op_param from the commanded state and beacons
 * every op_param*100 ms (0 meaning AURA_BEACON_DEFAULT_MS). So
 * `aura op 0 100` from the dashboard re-rates every virtual device on every
 * board at once, through the real protocol.
 *
 * That matters more than it sounds. This board has no UART, so twenty boards
 * is twenty RTT sessions to change a number by hand — and a sweep where each
 * board is re-rated at a slightly different moment is not a sweep, it is a
 * smear. One broadcast changes them together.
 *
 * `sim rate <ms>` overrides locally for one board; `sim rate 0` gives it back
 * to the fleet.
 */
static uint32_t g_override_ms;   /* 0 = follow the commanded op_param */
static uint32_t g_applied_ms;    /* what the timer is currently set to */
static uint16_t g_n = SIM_DEVICES;
static bool     g_running = true;
static uint32_t g_tx;
static uint16_t g_cursor = 1;   /* slot 0 is the board's own beacon */

/* Local xorshift, seeded from the block so two boards differ from the first
 * frame rather than after their clocks drift apart. */
static uint32_t g_sim_rng;

static uint32_t sim_rnd(void)
{
	if (g_sim_rng == 0) {
		g_sim_rng = ((uint32_t)g_block << 16) ^ k_uptime_get_32() ^ 0x5bd1e995u;
		if (g_sim_rng == 0) {
			g_sim_rng = 1;
		}
	}
	g_sim_rng ^= g_sim_rng << 13;
	g_sim_rng ^= g_sim_rng >> 17;
	g_sim_rng ^= g_sim_rng << 5;
	return g_sim_rng;
}

/*
 * The rate one virtual device beacons at, in milliseconds.
 *
 * Normally this follows the fleet: op_param carries the NORMAL-mode cadence
 * in units of 100 ms, exactly as aura_band.c reads it, so a single broadcast
 * re-rates every board at the same instant. `sim rate <ms>` sets a local
 * override for one board; `sim rate 0` hands it back to the fleet.
 */
static uint32_t effective_interval(void)
{
	if (g_override_ms) {
		return g_override_ms;
	}

	const struct aura_cmd *st = aura_band_state();
	uint32_t p = st ? st->op_param : 0;

	return p ? p * 100u : AURA_BEACON_DEFAULT_MS;
}

/*
 * A dedicated thread, not the system workqueue.
 *
 * The first version submitted a work item from a k_timer at up to 600 Hz. Two
 * things are wrong with that. The system workqueue is shared with the rest of
 * Zephyr and each of these items holds it for about a millisecond inside the
 * radio transmit — at 600/s that is most of the queue's time, and anything
 * else needing it waits. And the workqueue stack was 2 kB, which is generous
 * for light work and thin for the 802.15.4 transmit path; the earlier
 * nrf5_rx overflow on this project was the same mistake one thread over.
 *
 * Priority 8 puts it BELOW aura_band's radio thread (6) and animation thread
 * (7) on purpose. This board is a real Pixel first and a load generator
 * second: if something has to give, it should be the synthetic traffic, not
 * the device's own behaviour.
 */
#define TX_STACK      2048
#define TX_PRIORITY   8

static K_THREAD_STACK_DEFINE(tx_stack, TX_STACK);
static struct k_thread tx_thread_data;

static void tx_thread(void *a, void *b, void *c)
{
	ARG_UNUSED(a); ARG_UNUSED(b); ARG_UNUSED(c);

	for (;;) {
		if (!g_running || g_n <= 1) {
			/* g_n == 1 means this board represents only itself, and
			 * aura_band is already beaconing for it. */
			k_msleep(100);
			continue;
		}

		uint32_t interval = effective_interval();
		/* g_n - 1 virtual slots: aura_band's own beacon is slot 0, and
		 * it is already paced by the same commanded interval. */
		uint32_t want = (interval * 1000u) / (g_n - 1);
		uint32_t slot = want < SLOT_MIN_US ? SLOT_MIN_US : want;

		/*
		 * Jitter the slot, for the same reason aura_band jitters its
		 * own beacon: twenty boards emitting on an identical fixed
		 * period can drift into phase and then stay there, colliding
		 * repeatedly instead of occasionally. Zero-mean, so the offered
		 * load this board reports is still the load it produces.
		 */
		uint32_t j = slot / 4;

		if (j >= 2) {
			slot = slot - (j / 2) + (sim_rnd() % j);
		}

		if (interval != g_applied_ms) {
			g_applied_ms = interval;
			if (slot != want) {
				LOG_WRN("%u devices at %u ms needs %u us slots; "
					"clamped to %u. Offered load is now LOWER "
					"than requested — do not report this run "
					"as %u ms.",
					g_n, interval, want, slot, interval);
			} else {
				LOG_INF("beacon interval %u ms -> %u frames/s",
					interval, (1000u * g_n) / interval);
			}
		}

		/*
		 * Echo the seq this board actually acted on. The virtual
		 * devices share one radio, so they acquire a command together
		 * — downlink delivery is measurable at BOARD granularity, not
		 * per virtual device. Twenty boards around a room still gives
		 * twenty independent samples, which is what the statistic is
		 * for.
		 */
		const struct aura_cmd *st = aura_band_state();
		uint16_t addr = ADDR_OF(g_cursor);

		/* A battery that varies per address, so the server's fleet view
		 * looks like a fleet rather than 3,000 identical rows. */
		uint8_t batt = (uint8_t)(60 + (addr % 41));

		aura_band_beacon_as(addr, AURA_CAPS_PIXEL_XIAO, batt, 0,
				    st ? st->seq : 0);
		g_tx++;

		/*
		 * Slot 0 belongs to aura_band's own beacon — the board really
		 * is that device, transmitting on its own schedule through the
		 * full stack. The virtual fleet is 1..g_n-1, so the board plus
		 * its virtual devices come to exactly g_n.
		 */
		g_cursor = (g_n > 1)
			? (uint16_t)(1 + (g_cursor % (g_n - 1)))
			: 0;

		k_sleep(K_USEC(slot));
	}
}

/* Kept as a no-op seam: the thread re-reads the interval every slot, so
 * there is nothing to reschedule. Callers stay readable. */
static void reschedule(void)
{
	g_applied_ms = 0;   /* force the next pass to log the new rate */
}

/* --------------------------------------------------------------- shell -- */

static int c_stats(const struct shell *sh, size_t argc, char **argv)
{
	ARG_UNUSED(argc); ARG_UNUSED(argv);

	const struct aura_cmd *st = aura_band_state();
	uint32_t iv = effective_interval();
	uint32_t fps = iv ? (1000u * g_n) / iv : 0;

	shell_print(sh, "block %u   virtual %u   addr %04X..%04X",
		    g_block, g_n, ADDR_OF(0), ADDR_OF(g_n ? g_n - 1 : 0));
	shell_print(sh, "real device addr %04X = slot 0 of this block "
			"(virtual fleet is slots 1..%u)",
		    aura_band_addr(), g_n ? g_n - 1 : 0);
	shell_print(sh, "interval %u ms (%s)  ->  %u frames/s from this board",
		    iv, g_override_ms ? "local override"
				      : "from op_param, fleet-wide", fps);
	shell_print(sh, "virtual beacons sent %u   %s",
		    g_tx, g_running ? "RUNNING" : "STOPPED");
	if (st) {
		shell_print(sh, "commanded: seq=%u grp=%02X anim=%u/%u op=%u/%u "
			    "rgb=%02X%02X%02X br=%u",
			    st->seq, st->group, st->anim_mode, st->anim_param,
			    st->op_mode, st->op_param, st->r, st->g, st->b,
			    st->bright);
	}
	shell_print(sh, "clock %s", aura_band_is_synced() ? "synced to gateway"
							  : "local only");
	return 0;
}

static int c_rate(const struct shell *sh, size_t argc, char **argv)
{
	ARG_UNUSED(argc);
	long ms = strtol(argv[1], NULL, 0);

	if (ms != 0 && (ms < 100 || ms > 60000)) {
		shell_print(sh, "0 (follow the fleet) or 100..60000 ms");
		return -EINVAL;
	}
	g_override_ms = (uint32_t)ms;
	reschedule();

	if (ms == 0) {
		shell_print(sh, "following the fleet: %u ms. Change it for "
			    "everyone with 'aura op 0 <param>' (param x 100 ms).",
			    effective_interval());
	} else {
		shell_print(sh, "THIS BOARD overridden to %u ms -> %u frames/s. "
			    "The rest of the fleet is unchanged; 'sim rate 0' "
			    "hands it back.",
			    g_override_ms, (1000u * g_n) / g_override_ms);
	}
	return 0;
}

static int c_devices(const struct shell *sh, size_t argc, char **argv)
{
	ARG_UNUSED(argc);
	long n = strtol(argv[1], NULL, 0);

	if (n < 0 || n > SIM_DEVICES) {
		shell_print(sh, "0..%u (compiled maximum)", SIM_DEVICES);
		return -EINVAL;
	}
	g_n = (uint16_t)n;
	g_cursor = 1;
	reschedule();
	shell_print(sh, "%u virtual devices", g_n);
	return 0;
}

/*
 * Move this board to another block, live.
 *
 * For the ~1-in-3 run where two boards derive the same block. The server shows
 * how many distinct blocks it can see; if that is fewer than the number of
 * boards powered up, pick a free one here rather than rebuilding anything.
 *
 * Not persisted — it lasts until reset, which is the length of a test run.
 */
static int c_block(const struct shell *sh, size_t argc, char **argv)
{
	if (argc < 2) {
		shell_print(sh, "block %u of %u   addr %04X..%04X",
			    g_block, (unsigned int)SIM_BLOCKS,
			    ADDR_OF(0), ADDR_OF(SIM_DEVICES - 1));
		return 0;
	}

	long n = strtol(argv[1], NULL, 0);

	if (n < 0 || n >= SIM_BLOCKS) {
		shell_print(sh, "0..%u", (unsigned int)SIM_BLOCKS - 1);
		return -EINVAL;
	}

	g_block = (uint16_t)n;
	g_cursor = 1;
	shell_print(sh, "block %u   addr %04X..%04X   "
			"(tell the server this range moved)",
		    g_block, ADDR_OF(0), ADDR_OF(SIM_DEVICES - 1));
	return 0;
}

static int c_csma(const struct shell *sh, size_t argc, char **argv)
{
	ARG_UNUSED(argc);
	bool on = strtol(argv[1], NULL, 0) != 0;

	aura_band_tx_csma(on);
	shell_print(sh, "%s", on
		? "CSMA/CA — listens before transmitting"
		: "DIRECT — shipping default, unslotted ALOHA at scale");
	return 0;
}

static int c_run(const struct shell *sh, size_t argc, char **argv)
{
	ARG_UNUSED(argc);
	g_running = strtol(argv[1], NULL, 0) != 0;
	reschedule();
	shell_print(sh, "virtual fleet %s (this board still beacons as itself)",
		    g_running ? "running" : "stopped");
	return 0;
}

static int c_zero(const struct shell *sh, size_t argc, char **argv)
{
	ARG_UNUSED(argc); ARG_UNUSED(argv);
	g_tx = 0;
	shell_print(sh, "counter zeroed");
	return 0;
}

SHELL_STATIC_SUBCMD_SET_CREATE(sub_sim,
	SHELL_CMD_ARG(stats,   NULL, "Offered load, commanded state, clock", c_stats, 1, 0),
	SHELL_CMD_ARG(rate,    NULL, "Beacon interval: rate <ms>", c_rate, 2, 0),
	SHELL_CMD_ARG(devices, NULL, "Virtual devices: devices <n>", c_devices, 2, 0),
	SHELL_CMD_ARG(block,   NULL, "Address block: block [n]", c_block, 1, 1),
	SHELL_CMD_ARG(csma,    NULL, "csma <0|1> — DIRECT vs CSMA/CA", c_csma, 2, 0),
	SHELL_CMD_ARG(run,     NULL, "run <0|1>", c_run, 2, 0),
	SHELL_CMD_ARG(zero,    NULL, "Zero the counter", c_zero, 1, 0),
	SHELL_SUBCMD_SET_END
);
SHELL_CMD_REGISTER(sim, &sub_sim, "Load generator (the fleet layer is real)", NULL);

/* ---------------------------------------------------------------- main -- */

int main(void)
{
	/*
	 * CONFIG_SIM_BLOCK >= 0 pins this board explicitly and is what the old
	 * tagNN.conf fragments set. Left at the default -1 the board derives
	 * its own block, which is the whole point: one binary, twenty boards.
	 */
	g_block = (CONFIG_SIM_BLOCK >= 0)
		? (uint16_t)CONFIG_SIM_BLOCK
		: derive_block();

	/*
	 * Be device 0 of our own block rather than a 151st device standing
	 * outside it. Without this the board's own FICR-derived address lands
	 * anywhere in the band: the fleet counts 151 per board, and 4.9% of the
	 * time that address falls inside some other board's block and
	 * impersonates one of its devices.
	 */
	aura_band_addr_override(ADDR_OF(0));

	g_led_ready = led_init();
	if (!g_led_ready) {
		LOG_WRN("no LED — commands will land but nothing will show");
	}

	struct aura_band_cfg cfg = {
		.caps = AURA_CAPS_PIXEL_XIAO,

		/* Group 0x01, the same group the K4 Pixels use, so 'aura cmd
		 * 00 ...' and a group-01 command both reach these boards and
		 * the simulated fleet behaves as part of the real one. */
		.group_mask = 0x01,

		.render = render,
		.battery_pct = NULL,
		.antenna_external = false,
		.progress = NULL,
	};

	if (aura_band_init(&cfg) != 0) {
		LOG_ERR("aura_band_init failed");
		return -1;
	}

	/*
	 * Offset the boards against each other. Twenty of them powered from
	 * one hub would otherwise start their cycles on the same millisecond
	 * and stay in lockstep, manufacturing collisions a real fleet would
	 * not have.
	 */
	k_msleep(80 + (g_block * 37) % 500);

	k_thread_create(&tx_thread_data, tx_stack, TX_STACK,
			tx_thread, NULL, NULL, NULL, TX_PRIORITY, 0, K_NO_WAIT);
	k_thread_name_set(&tx_thread_data, "loadgen");

	printk(">LOADGEN block=%u virtual=%u addr=%04X..%04X real=%04X "
	       "interval=%ums group=%02X\n",
	       g_block, g_n, ADDR_OF(0), ADDR_OF(SIM_DEVICES - 1),
	       aura_band_addr(), effective_interval(), cfg.group_mask);
	return 0;
}
```
